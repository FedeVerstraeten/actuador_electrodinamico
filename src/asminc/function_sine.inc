;******************************************************************
; Materia......: Laboratorio de Microprocesadores.
; Curso........: Campigglio - Stola
; Fecha inicio.: 14/03/2016
; Fecha entrega: 21/06/2016
; Autores......:
;		 Ezequiel Martín Zarza
;		 Santiago Roman
;		 Federico Verstraeten
;
; Contacto.....:
;		 ezequielm.zarza@gmail.com
;		 santiago_roman@outlook.com
;		 federico.verstraeten@gmail.com
;
;******************************************************************
;	SENO ASSEMBLY
;******************************************************************
; Rutina para tenes a la salida del DAC un seno precargado
;******************************************************************

 

 
 .ORG $0000

 ldi R16, 0xFF
 out DDRC, R16; Hago que el puerto C sea de salida
 
 sine:
 
 ldi R31,HIGH(MSG<<1)
ldi R30,LOW(MSG<<1); Z APUNTA A MSG

 ascending_cycle:	lpm R16, Z+


		nop
		nop
		nop

		out PORTC, R16	;Mando R16 al puerto B
		cpi R16,251
		breq change_cycle
		nop
		rjmp ascending_cycle

change_cycle:

		ldi R31,HIGH(MSG2<<1)
		ldi R30,LOW(MSG2<<1); Y APUNTA A MSG2


	descending_cycle:	

		nop
		nop
		nop


		lpm R16, Z+
		out PORTC, R16	;Mando R16 al puerto C
		cpi R16,5
		breq here
		nop
		rjmp descending_cycle
		
			
Here: JMP sine

.ORG 0x500

;*********************************Lo hice con dos tablas para que quede un poco mas prolijo******************************************
;*********************************La primera es la parte ascendente y la segunda la decendiente**************************************

MSG: .DB  0, 0, 0, 0, 0, 0, 0, 1, 1, 2, 3, 3, 4, 5, 6, 7, 8, 9, 10, 12, 13, 15, 16, 18, 19, 21, 23, 25, 27, 29, 31, 33, 35, 37, 39, 42, 44, 46, 49, 51, 54, 56, 59, 62, 64, 67, 70, 73, 76, 79, 81, 84, 87, 90, 93, 96, 99, 103,106,109,112,115,118,121,124,128,131,134,137,140,143,146,149,152,156,159,162,165,168,171,174,176,179,182,185,188,191,193,196,199,201,204,206,209,211,213,216,218,220,222,224,226,228,230,232,234,236,237,239,240,242,243,245,246,247,248,249,250,251
MSG2: .DB 252,252,253,254,254,255,255,255,255,255,255,255,255,255,255,255,254,254,253,252,252,251,250,249,248,247,246,245,243,242,240,239,237,236,234,232,230,228,226,224,222,220,218,216,213,211,209,206,204,201,199,196,193,191,188,185,182,179,176,174,171,168,165,162,159,156,152,149,146,143,140,137,134,131,128,124,121,118,115,112,109,106,103,99, 96, 93, 90, 87, 84, 81, 79, 76, 73, 70, 67, 64, 62, 59, 56, 54, 51, 49, 46, 44, 42, 39, 37, 35, 33, 31, 29, 27, 25, 23, 21, 19, 18, 16, 15, 13, 12, 10, 9, 8, 7, 6, 5, 4, 3, 3,2,1,1, 0, 0, 0, 0, 0, 0;, 0, 0, 0, 0, 0, 1, 1, 2, 3, 3, 4, 5, 6, 7, 8, 9, 10, 12, 13, 15, 16, 18, 19, 21, 23, 25, 27, 29, 31, 33, 35, 37, 39, 42, 44, 46, 49, 51, 54, 56, 59, 62, 64, 67, 70, 73, 76, 79, 81, 84, 87, 90, 93, 96, 99, 103,106,109,112,115,118,121,124

